## main/Kconfig.projbuild
```kconfig
menu "ESP32-S3 MPU6050 Motion Configuration"

    config MPU6050_I2C_SDA
        int "I2C SDA GPIO"
        default 10
        help
            GPIO number for I2C SDA. Avoid GPIO26-37 on ESP32-S3 N16R8 (Octal PSRAM).

    config MPU6050_I2C_SCL
        int "I2C SCL GPIO"
        default 11
        help
            GPIO number for I2C SCL. Avoid GPIO26-37 on ESP32-S3 N16R8 (Octal PSRAM).

    config MPU6050_I2C_FREQ_HZ
        int "I2C Clock Frequency (Hz)"
        default 400000
        range 100000 400000

    config MPU6050_I2C_ADDR
        hex "MPU6050 I2C Address"
        default 0x68
        help
            0x68 when AD0 is LOW (GND), 0x69 when AD0 is HIGH (3.3V).

endmenu
```

## sdkconfig.defaults
```kconfig
CONFIG_IDF_TARGET="esp32s3"
CONFIG_ESPTOOLPY_FLASHSIZE_16MB=y
CONFIG_SPIRAM=y
CONFIG_SPIRAM_MODE_OCT=y
CONFIG_SPIRAM_SPEED_80M=y
CONFIG_ESP_CONSOLE_UART_DEFAULT=y
CONFIG_ESP_CONSOLE_UART_BAUDRATE=115200
CONFIG_ESP_CONSOLE_SECONDARY_USB_SERIAL_JTAG=y
CONFIG_FREERTOS_HZ=1000
CONFIG_MPU6050_I2C_SDA=10
CONFIG_MPU6050_I2C_SCL=11
```
